## boards/arm/frdm_kl43z/Kconfig.board
```kconfig
# Kconfig - FRDM-KL43Z board
#
# Copyright (c) 2019, NXP
#
# SPDX-License-Identifier: Apache-2.0
#

config BOARD_FRDM_KL43Z
	bool "NXP FRDM-KL43Z"
	depends on SOC_SERIES_KINETIS_KL4X
	select SOC_PART_NUMBER_MKL43Z128VLH4
```

## subsys/knot/Kconfig
```kconfig
# Kconfig - KNoT platform


menu "KNoT"

config KNOT
	bool "Enable KNoT platform"
	help
	  This option enable to use the KNoT protocol
if KNOT

menuconfig KNOT_LOG
	bool "Enable log messages from KNoT"
	select SYS_LOG
	help
	  This option enable log messages in the  KNoT protocol.

if KNOT_LOG

config SYS_LOG_KNOT_LEVEL
	int "KNoT logging level"
	default 1
	depends on SYS_LOG
	range 0 4
	help
	  Sets log level for the KNoT plataform.
	  Levels are:
	  0 OFF, do not write
	  1 ERROR, only write SYS_LOG_ERR
	  2 WARNING, write SYS_LOG_WRN in addition to previous level
	  3 INFO, write SYS_LOG_INF in addition to previous levels
	  4 DEBUG, write SYS_LOG_DBG in addition to previous levels

endif # KNOT_DEBUG

endif # KNOT
endmenu
```
